## app/boards/shields/splittyboi/Kconfig.shield
```kconfig
# Copyright (c) 2020 The ZMK Contributors
# SPDX-License-Identifier: MIT

config SHIELD_SPLITTYBOI_LEFT
    def_bool $(shields_list_contains,splittyboi_left)

config SHIELD_SPLITTYBOI_RIGHT
    def_bool $(shields_list_contains,splittyboi_right)
```
